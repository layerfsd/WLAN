PROVIDE ( _indir_tbl = 0x80000700 );
PROVIDE ( cmnos_allocram_module_install = 0x8000a118 );
PROVIDE ( memcpy = 0x8000e770 );
PROVIDE ( memset = 0x8000e9b0 );
PROVIDE ( timer_list = 0x80001eb0 );
PROVIDE ( timer_insert = 0x8000cc80 );
PROVIDE ( memcmp = 0x8000e6f0 );
PROVIDE ( memmove = 0x8000e888 );
PROVIDE ( strcpy = 0x8000ead0 );
PROVIDE ( strncpy = 0x8000ecc0 );
PROVIDE ( strlen = 0x8000eb5c );
PROVIDE ( strcmp = 0x8000ea64 );
PROVIDE ( strncmp = 0x8000eb74 );
PROVIDE ( cmnos_delay_us = 0x8000aaa4 );
PROVIDE ( cmnos_dsr_attach = 0x8000b5c8 );
PROVIDE ( cmnos_milliseconds = 0x8000aaf4 );
PROVIDE ( cmnos_printf = 0x8000c8f4 );
PROVIDE ( cmnos_refclk_speed_get = 0x8000ab10 );
PROVIDE ( cmnos_timer_arm = 0x8000cd04 );
PROVIDE ( cmnos_timer_disarm = 0x8000cddc );
PROVIDE ( cmnos_timer_setfn = 0x8000cc64 );
PROVIDE ( cmnos_uart_frequency = 0x8000ab1c );
PROVIDE ( cmnos_dsr_detach = 0x8000b708 );
PROVIDE ( cmnos_intr_mask_inum = 0x8000b69c );
PROVIDE ( cmnos_intr_unmask_inum = 0x8000b964 );
PROVIDE ( cmnos_isr_attach = 0x8000b7bc );
PROVIDE ( cmnos_isr_detach = 0x8000b890 );
PROVIDE ( cmnos_power_syssleep_control = 0x8000c114 );
PROVIDE ( cmnos_timer_done = 0x8000ce6c );
PROVIDE ( cmnos_power_uart_control = 0x8000c0e0 );
PROVIDE ( cmnos_serial_getc = 0x8000cad8 );
PROVIDE ( cmnos_serial_hwinit = 0x8000c9bc );
PROVIDE ( cmnos_wlan_band_set = 0x8000ab34 );
PROVIDE ( cmnos_wdt_enable = 0x8000d068 );
PROVIDE ( cmnos_bddata_addr = 0x8000a170 );
PROVIDE ( cmnos_wdt_current_action = 0x8000d038 );
PROVIDE ( cmnos_bddata_setup = 0x8000a134 );
PROVIDE ( cmnos_system_reset = 0x8000bcc4 );
PROVIDE ( cmnos_dcache_flush = 0x8000a9b0 );
PROVIDE ( cmnos_dcache_invalidate = 0x8000aa00 );
PROVIDE ( cmnos_target_id_get = 0x8000bf60 );
PROVIDE ( cmnos_is_host_present = 0x8000bf6c );
PROVIDE ( cmnos_wdt_disable = 0x8000d144 );
PROVIDE ( cmnos_wdt_restore = 0x8000d19c );
PROVIDE ( cmnos_allocram = 0x8000a09c );
PROVIDE ( cmnos_mbox_word_pop = 0x8000bbe0 );
PROVIDE ( cmnos_mac_reset = 0x8000bcec );
PROVIDE ( cmnos_serial_init = 0x8000cb1c );
PROVIDE ( cmnos_printf_init = 0x8000c954 );
